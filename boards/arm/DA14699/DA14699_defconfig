## boards/arm/DA14699/Kconfig.board
```kconfig
config BOARD_DA14699
	bool "DA14699 dual core BLE SOC"
	depends on SOC_SERIES_DA1469x
	select SOC_PART_NUMBER_DA14699

config SOC_DA14699
	bool "SOC_DA14699"
```

## boards/arm/da1469x_dev_kit_pro/Kconfig.board
```kconfig
config BOARD_DA1469X_DEV_KIT_PRO
   bool "DA1469x dual core BLE SOC series board"
   depends on SOC_SERIES_DA1469X
   select SOC_PART_NUMBER_DA14699
   select CPU_HAS_FPU
   select DISK_DRIVERS
```

## boards/arm/da1469x_dev_kit_pro/Kconfig.defconfig
```kconfig
if BOARD_DA1469X_DEV_KIT_PRO

# Always set CONFIG_BOARD here. This isn't meant to be customized,
# but is set as a "default" due to Kconfig language restrictions.
config BOARD
   default "da1469x_dev_kit_pro"

if FLASH

config SOC_FLASH_DA1469X
	default y

endif

if SERIAL

config UART_DA1469X
	default y
   select SERIAL_SUPPORT_INTERRUPT

endif # SERIAL

if DISK_DRIVER_FLASH

config DISK_FLASH_DEV_NAME
	default "flash"

config DISK_FLASH_START
	default 0xf8000

config DISK_FLASH_MAX_RW_SIZE
	default 4

config DISK_ERASE_BLOCK_SIZE
	default 0x1000

config DISK_FLASH_ERASE_ALIGNMENT
	default 0x1000

config DISK_VOLUME_SIZE
	default 0x8000

endif # DISK_DRIVER_FLASH

endif # BOARD_DA1469X_DEV_KIT_PRO
```

## boards/arm/da1469x_dev_kit_pro/da1469x_dev_kit_pro_defconfig
```kconfig
CONFIG_BOARD_DA1469X_DEV_KIT_PRO=y
CONFIG_SOC_SERIES_DA1469X=y
CONFIG_SOC_DA14699=y
CONFIG_GPIO=y
CONFIG_SYS_CLOCK_HW_CYCLES_PER_SEC=32000000
CONFIG_BUILD_OUTPUT_HEX=y
CONFIG_XIP=y
# CONFIG_NO_OPTIMIZATIONS=y
CONFIG_CORTEX_M_SYSTICK=y

CONFIG_RUNTIME_NMI=y
# CONFIG_ARM_TRUSTZONE_M=y

CONFIG_CONSOLE=y
CONFIG_UART_CONSOLE=y
CONFIG_SERIAL=y
CONFIG_UART_DA1469X=y
```

## drivers/flash/Kconfig.da1469x
```kconfig
# SPDX-License-Identifier: Apache-2.0

config SOC_FLASH_DA1469X
	bool "da1469x flash shim driver"
	select FLASH_HAS_PAGE_LAYOUT
	select FLASH_HAS_DRIVER_ENABLED
	help
	  Enables the RV32M1 flash shim driver.
	  WARNING: This driver will disable the system interrupts for
	  the duration of the flash erase/write operations. This will
	  have an impact on the overall system performance - whether
	  this is acceptable or not will depend on the use case.
```

## drivers/gpio/Kconfig.da1469x
```kconfig
config GPIO_DA1469X
	bool "DA1469X GPIO driver"
	depends on HAS_DA1469X_GPIO
	help
	  Enable the DA1469x GPIO driver.
```

## drivers/serial/Kconfig.da1469x
```kconfig
config UART_DA1469X
	bool "ARM DA1469x UART driver"
	select SERIAL_HAS_DRIVER
	help
	  This option enables the UART driver for ARM DA1469x.
```

## dts/bindings/gpio/renesas,DA1469x-gpio.yaml
```yaml
description: DA1469x GPIO node

compatible: "renesas,DA1469x-gpio"

include: [gpio-controller.yaml, base.yaml]

properties:
    reg:
      required: true

    label:
      required: true

    "#gpio-cells":
      const: 2

    port:
      type: int
      required: true

gpio-cells:
  - pin
  - flags
```

## dts/bindings/serial/renesas,DA1469x-uart.yaml
```yaml
description: Renesas DA1469x uart

compatible: "renesas,DA1469x-uart"

include: uart-controller.yaml

properties:
    reg:
      required: true

    rx_pin:
      type: int
      required: true

    rx_port:
      type: phandle
      required: true

    tx_pin:
      type: int
      required: true

    tx_port:
      type: phandle
      required: true

    stop_bits:
      type: int
      required: true
      enum: 
        - 1
        - 2

    data_bits:
      type: int
      required: true
      enum:
        - 5
        - 6
        - 7
        - 8

    uart_id:
      type: int
      required: true
      enum:
        - 1
        - 2
        - 3
```

## soc/arm/DA1469x/Kconfig
```kconfig
config SOC_FAMILY_DA1469X
	bool

if SOC_FAMILY_DA1469X

config SOC_FAMILY
	string
	default "da1469x"

source "soc/arm/da1469x/*/Kconfig.soc"

config SOC_PART_NUMBER
	default SOC_PART_NUMBER_DA14699 if SOC_SERIES_DA1469X

endif # SOC_FAMILY_DA1469X
```

## soc/arm/da1469x/Kconfig.series
```kconfig
config SOC_SERIES_DA1469X
	bool "DA1469X Series Dual Core BLE"
	select ARM
	select CPU_CORTEX_M33
```

## soc/arm/da1469x/da14699/Kconfig.defconfig.da14699
```kconfig
# Infineon XMC4500 relax kit platform configuration options
#
# Copyright (c) 2020 Linumiz
# Author: Parthiban Nallathambi <parthiban@linumiz.com>
# SPDX-License-Identifier: Apache-2.0

if SOC_DA14699

config SOC
	default "DA14699"

config NUM_IRQS
	default 65
	
config SYS_CLOCK_HW_CYCLES_PER_SEC
	default 32000000

endif # SOC_DA14699
```

## soc/arm/da1469x/da14699/Kconfig.defconfig.series
```kconfig
if SOC_SERIES_DA1469X

config SOC_SERIES
	default "da14699"

source "soc/arm/da1469x/da14699/Kconfig.defconfig.da1469*"

endif # SOC_SERIES_DA1469X
```

## soc/arm/da1469x/da14699/Kconfig.series
```kconfig
config SOC_SERIES_DA1469X
	bool "DA1469x dual core ble"
	select ARM
	select CPU_CORTEX_M33
	select SOC_FAMILY_DA1469X
	select HAS_DA1469X_GPIO
	help
	  Enable support for DA1469c dual core ble devices
```

## soc/arm/da1469x/da14699/Kconfig.soc
```kconfig
choice
	prompt "DA1469x dual core ble device Selection"
	depends on SOC_SERIES_DA1469X

config SOC_DA14699
	bool "SOC_DA14699"

endchoice

if SOC_SERIES_DA1469X

config SOC_PART_NUMBER_DA14699
	bool

config GPIO_DA1469X
	default y
	
# config UART_DA1469X
# 	 default y
# 	 select GPIO_DA1469X

endif # SOC_SERIES_DA1469X
```
